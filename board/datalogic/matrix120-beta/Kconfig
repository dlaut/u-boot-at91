## board/datalogic/matrix120-beta/Kconfig
```kconfig
if TARGET_MATRIX120_BETA

config SYS_BOARD
	default "matrix120-beta"

config SYS_VENDOR
	default "datalogic"

config SYS_SOC
	default "at91"

config SYS_CONFIG_NAME
	default "matrix120-beta"

config ATMEL_SPI0
	bool "SPI0"
	default y

config ATMEL_SDHCI0
	bool "SDHCI0"
	select ATMEL_SDHCI
	default y

config ATMEL_SDHCI1
	bool "SDHCI1"
	select ATMEL_SDHCI
	default y

config ATMEL_QSPI0
	bool "QSPI0"
	select DM_SPI
	select ATMEL_QSPI
	default n

config SYS_PTS_TARGET_ABI
	string "PTS target os type"
	default "-musleabi"
	help
	  This option should contain the name of the target os type.

endif
```

## configs/matrix120-beta_qspiflash_defconfig
```kconfig
CONFIG_ARM=y
CONFIG_ARCH_AT91=y
CONFIG_TARGET_MATRIX120_BETA=y
# CONFIG_ATMEL_SPI0 is not set
# CONFIG_ATMEL_SDHCI1 is not set
CONFIG_ATMEL_QSPI0=y
CONFIG_DEFAULT_DEVICE_TREE="matrix120-beta"
CONFIG_FIT=y
CONFIG_SYS_EXTRA_OPTIONS="SAMA5D2,SYS_USE_QSPIFLASH"
# CONFIG_CMD_IMI is not set
# CONFIG_CMD_IMLS is not set
CONFIG_CMD_SF=y
CONFIG_OF_CONTROL=y
CONFIG_DM=y
CONFIG_SPI_FLASH_ABOVE_16MB=y
#CONFIG_SPI_FLASH_4B_OPCODES=y
CONFIG_SPI_FLASH_MACRONIX=y
CONFIG_SPI_FLASH_STMICRO=y
#CONFIG_SPI_FLASH_USE_4K_SECTORS=y
CONFIG_DM_SPI_FLASH=y
CONFIG_SPI_FLASH_MTD=y
CONFIG_MTD=y
CONFIG_CMD_UBI=y
CONFIG_CMD_UBIFS=y
CONFIG_RBTREE=y
CONFIG_MTD_DEVICE=y
CONFIG_MTD_PARTITIONS=y
CONFIG_CMD_MTDPARTS=y
CONFIG_LZO=y
CONFIG_CMD_GPIO=y
```

## fs/ubifs/Kconfig
```kconfig
config CMD_UBIFS
	bool "ubifs"
	select LZO
	help
	  Adds commands for interacting with UBI volumes formatted as
	  UBIFS.  UBIFS is read-only in u-boot.

config UBIFS_SILENCE_MSG
	bool "Silence UBIFS messages"
	default y if ENV_IS_IN_UBI
	depends on CMD_UBIFS
	help
	  Make the verbose messages from UBIFS stop printing. This
	  leaves warnings and errors enabled.
```
